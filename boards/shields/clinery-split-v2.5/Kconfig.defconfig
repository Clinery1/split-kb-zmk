## boards/shields/clinery-split-v2.5/Kconfig.defconfig
```kconfig
if SHIELD_CLINERY_SPLIT_V2_5_LEFT

# Name must be less than 16 characters long!
config ZMK_KEYBOARD_NAME
    default "Chris Keyboard"

config ZMK_SPLIT_ROLE_CENTRAL
    default y

endif

if SHIELD_CLINERY_SPLIT_V2_5_LEFT || SHIELD_CLINERY_SPLIT_V2_5_RIGHT

config ZMK_SPLIT
    default y

endif
```

## boards/shields/clinery-split-v2.5/Kconfig.shield
```kconfig
# No whitespace after the comma or in your part name!
config SHIELD_CLINERY_SPLIT_V2_5_LEFT
    def_bool $(shields_list_contains,clinery_split_v2_5_left)

# No whitespace after the comma or in your part name!
config SHIELD_CLINERY_SPLIT_V2_5_RIGHT
    def_bool $(shields_list_contains,clinery_split_v2_5_right)
```

## boards/shields/clinery_split_v2_5/Kconfig.defconfig
```kconfig
if SHIELD_CLINERY_SPLIT_V2_5_LEFT

config ZMK_KEYBOARD_NAME
    default "Chris Keyboard"

config ZMK_SPLIT_ROLE_CENTRAL
    default y

endif # SHIELD_CLINERY_SPLIT_V2_5_LEFT

if SHIELD_CLINERY_SPLIT_V2_5_LEFT || SHIELD_CLINERY_SPLIT_V2_5_RIGHT

config ZMK_SPLIT
    default y

endif # SHIELD_CLINERY_SPLIT_V2_5_LEFT || SHIELD_CLINERY_SPLIT_V2_5_RIGHT
```

## boards/shields/clinery_split_v2_5/Kconfig.shield
```kconfig
config SHIELD_CLINERY_SPLIT_V2_5_LEFT
    def_bool $(shields_list_contains,clinery_split_v2_5_left)

config SHIELD_CLINERY_SPLIT_V2_5_RIGHT
    def_bool $(shields_list_contains,clinery_split_v2_5_right)
```
